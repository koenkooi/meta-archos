## conf/layer.conf
```bitbake
# We have a conf directory, append it to BBPATH
BBPATH .= ":${LAYERDIR}"

# We have a recipes directory, add to BBFILES
BBFILES += "${LAYERDIR}/recipes*/*/*.bb ${LAYERDIR}/recipes*/*/*.bbappend"

BBFILE_COLLECTIONS += "archos"
BBFILE_PRIORITY_archos = "1"
BBFILE_PATTERN_archos = "${LAYERDIR}"
```

## conf/machine/archosa32.conf
```bitbake
#@TYPE: Machine
#@NAME: OMAP3 based Archos A32
#@DESCRIPTION: Machine configuration for the Archos A32 (Gen8)

TARGET_ARCH = "arm"
require conf/machine/include/omap3.inc

ASSUME_PROVIDED += "u-boot x-load"

PREFERRED_PROVIDER_virtual/xserver = "xserver-xorg"
XSERVER = "xserver-xorg \
           xf86-input-evdev \
           xf86-input-mouse \
           xf86-input-tslib \
           xf86-video-omapfb \
           xf86-input-keyboard"

#What is the correct one, both seem in use?
MACHINE_GUI_CLASS = "bigscreen"
GUI_MACHINE_CLASS = "bigscreen"

#800 * 480 Widescreen
MACHINE_DISPLAY_WIDTH_PIXELS = "240"
MACHINE_DISPLAY_HEIGHT_PIXELS = "320"

KERNEL_IMAGETYPE = "zImage"

PREFERRED_PROVIDER_virtual/kernel = "linux-omap-archos"

# Ship all kernel modules
MACHINE_EXTRA_RRECOMMENDS = "kernel-modules"

IMAGE_FSTYPES += "tar.bz2"
EXTRA_IMAGECMD_jffs2 = "-lnp "

SERIAL_CONSOLE = "115200 ttyS2"

CMDLINE = "console=ttyS2,115200n8 androidboot.console=ttyS2 extrabaud=1000000 init=/linuxrc debug omapdss.debug=0 vram=4915200 omapfb.vram=0:4915200 omapfb.debug=0"

MACHINE_FEATURES = "kernel26 apm usbgadget usbhost keyboard vfat ext2 screen touchscreen wifi"
```
